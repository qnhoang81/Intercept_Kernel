## drivers/media/s3c6410/g3d/Kconfig
```kconfig
#
# G3D subsystem configuration
#

menu "G3D Support"

config VIDEO_G3D
	tristate "OpenFIMG FIMG-3DSE Driver"
#	bool "Samsung FIMG-3DSE Driver"
	default n
	help
		FIMG-3D

endmenu
```
